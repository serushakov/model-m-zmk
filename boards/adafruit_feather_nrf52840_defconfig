## boards/adafruit_feather_nrf52840_defconfig
```kconfig
# Logger cannot use itself to log
CONFIG_USB_CDC_ACM_LOG_LEVEL_OFF=y

# Enable USB
CONFIG_USB_DEVICE_STACK=y

# Build UF2 by default, supported by the Adafruit nRF52 Bootloader
CONFIG_BUILD_OUTPUT_UF2=y
```

## boards/shields/ibm-model-m/Kconfig.shield
```kconfig
# No whitespace after the comma or in your keyboard name!
config SHIELD_IMB_MODEL_M
    def_bool $(shields_list_contains,ibm_model_m)
```

## boards/shields/ibm_model_m/Kconfig.defconfig
```kconfig
if SHIELD_IBM_MODEL_M

config ZMK_KEYBOARD_NAME
    default "ibm-model-m"

endif # SHIELD_IBM_MODEL_M
```

## boards/shields/modelm/Kconfig.defconfig
```kconfig
if SHIELD_MODELM

# Name must be less than 16 characters long!
config ZMK_KEYBOARD_NAME
    default "IBM Model M"

endif
```

## boards/shields/modelm/Kconfig.shield
```kconfig
# No whitespace after the comma or in your keyboard name!
config SHIELD_MODELM
    def_bool $(shields_list_contains,modelm)
```

## config/boards/shields/ibm-model-m/Kconfig.defconfig
```kconfig
if SHIELD_IMB_MODEL_M

# Name must be less than 16 characters long!
config ZMK_KEYBOARD_NAME
    default "IBM Model M"

endif
```
